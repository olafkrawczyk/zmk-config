#include <dt-bindings/zmk/matrix_transform.h>

/ {
    esb_split {
        compatible = "zmk,esb-split";
        // Each base address must be 8 bytes
        base-addr-0 = <0xE7 0xE7 0xE7 0xE7 0xE7 0xE7 0xE7 0xE7>;
        base-addr-1 = <0xC2 0xC2 0xC2 0xC2 0xC2 0xC2 0xC2 0xC2>;
        // Prefix must be 4 bytes
        addr-prefix = <0xE7 0xC2 0xC3 0xC4>;
    };
};
