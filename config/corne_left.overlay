/ {
    esb_split {
        compatible = "zmk,esb-split";
        // Peripherals expect 4-byte base addresses in this module version
        base-addr-0 = [E7 E7 E7 E7];
        base-addr-1 = [C2 C2 C2 C2];
        addr-prefix = [E7 C2 C3 C4];
    };
};
