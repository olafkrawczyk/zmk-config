/ {
    esb_split {
        compatible = "zmk,esb-split";
        // Peripherals expect 4-byte base addresses
        base-addr-0 = /bits/ 8 <0xE7 0xE7 0xE7 0xE7>;
        base-addr-1 = /bits/ 8 <0xC2 0xC2 0xC2 0xC2>;
        addr-prefix = /bits/ 8 <0xE7 0xC2 0xC3 0xC4>;
    };
};
