## boards/shields/corne_dongle/Kconfig.defconfig
```kconfig
if SHIELD_CORNE_DONGLE

config ZMK_KEYBOARD_NAME
    default "Corne Dongle"

config ZMK_SPLIT_BLE_ROLE_CENTRAL
    default y

config ZMK_USB
    default y

endif
```

## config/Kconfig
```kconfig
menu "User display options"

config ZMK_DISPLAY_SHOW_LAYER
    bool "Show layer name on display"
    default y

config ZMK_LAYER_DISPLAY_RELAY
    bool "Relay layer state to left peripheral"
    default n

config ZMK_LAYER_DISPLAY_LEFT_SOURCE
    int "Left peripheral source ID"
    default 0
    depends on ZMK_LAYER_DISPLAY_RELAY

endmenu
```

## dts/bindings/behaviors/zmk,behavior-layer-display.yaml
```yaml
description: Set display layer index on peripheral

compatible: "zmk,behavior-layer-display"

include: behavior.yaml

properties:
  "#binding-cells":
    const: 1
  label:
    type: string
    required: true
```
